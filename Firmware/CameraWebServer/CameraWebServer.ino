#include "esp_camera.h"
#include <WiFi.h>
#include "esp_timer.h"
#include "esp_camera.h"
#include "img_converters.h"
#include "fb_gfx.h"
#include "driver/ledc.h"
#include "sdkconfig.h"
#include "esp_log.h"
#include <AsyncTCP.h>
#include <ESPAsyncWebServer.h>
#include <ArduinoJson.h>

const char* ssid = "Frontier2976";
const char* password = "0550337623";

// Create AsyncWebServer object on port 80

const int ledPin = 2;
AsyncWebServer server(8000);
AsyncWebSocket ws("/");


void handleWebSocketMessage(void *arg, uint8_t *data, size_t len) {
  AwsFrameInfo *info = (AwsFrameInfo*)arg;
  if (info->final && info->index == 0 && info->len == len && info->opcode == WS_TEXT) {
    data[len] = 0;    
    Serial.println((char*)data);    
    // Deserialize the JSON document
    DynamicJsonDocument command(1024);
    deserializeJson(command, (char*)data);    
    int left = command["left"];
    Serial.println(left);
    if(left > 0){
      digitalWrite(ledPin, HIGH);
    }else{
      digitalWrite(ledPin, LOW);
    }
  }
}

void onEvent(AsyncWebSocket *server, AsyncWebSocketClient *client, AwsEventType type,
             void *arg, uint8_t *data, size_t len) {
  switch (type) {
    case WS_EVT_CONNECT:
      Serial.printf("WebSocket client #%u connected from %s\n", client->id(), client->remoteIP().toString().c_str());
      break;
    case WS_EVT_DISCONNECT:
      Serial.printf("WebSocket client #%u disconnected\n", client->id());
      break;
    case WS_EVT_DATA:      
      handleWebSocketMessage(arg, data, len);
      break;
    case WS_EVT_PONG:
    case WS_EVT_ERROR:
      break;
  }
}

void initWebSocket() {
  ws.onEvent(onEvent);
  server.addHandler(&ws);
}


//
// WARNING!!! PSRAM IC required for UXGA resolution and high JPEG quality
//            Ensure ESP32 Wrover Module or other board with PSRAM is selected
//            Partial images will be transmitted if image exceeds buffer size
//

#define CAMERA_MODEL_AI_THINKER // Has PSRAM

#define PWDN_GPIO_NUM     32
#define RESET_GPIO_NUM    -1
#define XCLK_GPIO_NUM      0
#define SIOD_GPIO_NUM     26
#define SIOC_GPIO_NUM     27

#define Y9_GPIO_NUM       35
#define Y8_GPIO_NUM       34
#define Y7_GPIO_NUM       39
#define Y6_GPIO_NUM       36
#define Y5_GPIO_NUM       21
#define Y4_GPIO_NUM       19
#define Y3_GPIO_NUM       18
#define Y2_GPIO_NUM        5
#define VSYNC_GPIO_NUM    25
#define HREF_GPIO_NUM     23
#define PCLK_GPIO_NUM     22
#define index_ov2640_html_gz_len 6787
//edit the html page below here: https://gchq.github.io/CyberChef/#recipe=Gzip('Dynamic%20Huffman%20Coding','index.html.gz','',false)To_Hex('0x',0)Split('0x',',0x')
const uint8_t index_ov2640_html_gz[] = {0x1f,0x8b,0x08,0x08,0xe6,0xd4,0x82,0x62,0x00,0xff,0x69,0x6e,0x64,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0x00,0x00};
#define PART_BOUNDARY "123456789000000000000987654321"

namespace webserver{
  #include "esp_http_server.h"
  static const char *TAG = "camera_httpd";
  static const char *_STREAM_CONTENT_TYPE = "multipart/x-mixed-replace;boundary=" PART_BOUNDARY;
  static const char *_STREAM_BOUNDARY = "\r\n--" PART_BOUNDARY "\r\n";
  static const char *_STREAM_PART = "Content-Type: image/jpeg\r\nContent-Length: %u\r\nX-Timestamp: %d.%06d\r\n\r\n";
  
  httpd_handle_t stream_httpd = NULL;
  httpd_handle_t camera_httpd = NULL;
  static esp_err_t stream_handler(httpd_req_t *req)
  {
      camera_fb_t *fb = NULL;
      struct timeval _timestamp;
      esp_err_t res = ESP_OK;
      size_t _jpg_buf_len = 0;
      uint8_t *_jpg_buf = NULL;
      char *part_buf[128];
  
      static int64_t last_frame = 0;
      if (!last_frame)
      {
          last_frame = esp_timer_get_time();
      }
  
      res = httpd_resp_set_type(req, _STREAM_CONTENT_TYPE);
      if (res != ESP_OK)
      {
          return res;
      }
  
      httpd_resp_set_hdr(req, "Access-Control-Allow-Origin", "*");
      httpd_resp_set_hdr(req, "X-Framerate", "60");
  
      while (true)
      {
          fb = esp_camera_fb_get();
          if (!fb)
          {
              ESP_LOGE(TAG, "Camera capture failed");
              res = ESP_FAIL;
          }
          else
          {
              _timestamp.tv_sec = fb->timestamp.tv_sec;
              _timestamp.tv_usec = fb->timestamp.tv_usec;
                  if (fb->format != PIXFORMAT_JPEG)
                  {
                      bool jpeg_converted = frame2jpg(fb, 80, &_jpg_buf, &_jpg_buf_len);
                      esp_camera_fb_return(fb);
                      fb = NULL;
                      if (!jpeg_converted)
                      {
                          ESP_LOGE(TAG, "JPEG compression failed");
                          res = ESP_FAIL;
                      }
                  }
                  else
                  {
                      _jpg_buf_len = fb->len;
                      _jpg_buf = fb->buf;
                  }
          }
          if (res == ESP_OK)
          {
              res = httpd_resp_send_chunk(req, _STREAM_BOUNDARY, strlen(_STREAM_BOUNDARY));
          }
          if (res == ESP_OK)
          {
              size_t hlen = snprintf((char *)part_buf, 128, _STREAM_PART, _jpg_buf_len, _timestamp.tv_sec, _timestamp.tv_usec);
              res = httpd_resp_send_chunk(req, (const char *)part_buf, hlen);
          }
          if (res == ESP_OK)
          {
              res = httpd_resp_send_chunk(req, (const char *)_jpg_buf, _jpg_buf_len);
          }
          if (fb)
          {
              esp_camera_fb_return(fb);
              fb = NULL;
              _jpg_buf = NULL;
          }
          else if (_jpg_buf)
          {
              free(_jpg_buf);
              _jpg_buf = NULL;
          }
          if (res != ESP_OK)
          {
              break;
          }
          int64_t fr_end = esp_timer_get_time();
  
          int64_t frame_time = fr_end - last_frame;
          last_frame = fr_end;
          frame_time /= 1000;
      }
  
      last_frame = 0;
      return res;
  }
  
  static esp_err_t index_handler(httpd_req_t *req)
  {
      httpd_resp_set_type(req, "text/html");
      httpd_resp_set_hdr(req, "Content-Encoding", "gzip");
      sensor_t *s = esp_camera_sensor_get();
      if (s != NULL) {        
        return httpd_resp_send(req, (const char *)index_ov2640_html_gz, index_ov2640_html_gz_len);       
      } else {
          ESP_LOGE(TAG, "Camera sensor not found");
          return httpd_resp_send_500(req);
      }
  }
  void startCameraServer()
  {
      httpd_config_t config = HTTPD_DEFAULT_CONFIG();
      config.max_uri_handlers = 16;
  
      httpd_uri_t index_uri = {
          .uri = "/",
          .method = HTTP_GET,
          .handler = index_handler,
          .user_ctx = NULL};
  
      httpd_uri_t stream_uri = {
          .uri = "/stream",
          .method = HTTP_GET,
          .handler = stream_handler,
          .user_ctx = NULL};    
  
      ESP_LOGI(TAG, "Starting web server on port: '%d'", config.server_port);
      Serial.printf("Starting web server on port: '%d'", config.server_port);
      if (httpd_start(&camera_httpd, &config) == ESP_OK)
      {
          httpd_register_uri_handler(camera_httpd, &index_uri);        
      }
  
      config.server_port += 1;
      config.ctrl_port += 1;
      ESP_LOGI(TAG, "Starting stream server on port: '%d'", config.server_port);
      Serial.printf("Starting stream server on port: '%d'", config.server_port);
      if (httpd_start(&stream_httpd, &config) == ESP_OK)
      {
          httpd_register_uri_handler(stream_httpd, &stream_uri);
      }
  }  
}




void setup() {
  Serial.begin(115200);
  Serial.setDebugOutput(true);
  Serial.println();

  camera_config_t config;
  config.ledc_channel = LEDC_CHANNEL_0;
  config.ledc_timer = LEDC_TIMER_0;
  config.pin_d0 = Y2_GPIO_NUM;
  config.pin_d1 = Y3_GPIO_NUM;
  config.pin_d2 = Y4_GPIO_NUM;
  config.pin_d3 = Y5_GPIO_NUM;
  config.pin_d4 = Y6_GPIO_NUM;
  config.pin_d5 = Y7_GPIO_NUM;
  config.pin_d6 = Y8_GPIO_NUM;
  config.pin_d7 = Y9_GPIO_NUM;
  config.pin_xclk = XCLK_GPIO_NUM;
  config.pin_pclk = PCLK_GPIO_NUM;
  config.pin_vsync = VSYNC_GPIO_NUM;
  config.pin_href = HREF_GPIO_NUM;
  config.pin_sscb_sda = SIOD_GPIO_NUM;
  config.pin_sscb_scl = SIOC_GPIO_NUM;
  config.pin_pwdn = PWDN_GPIO_NUM;
  config.pin_reset = RESET_GPIO_NUM;
  config.xclk_freq_hz = 20000000;
  config.pixel_format = PIXFORMAT_JPEG;
  config.frame_size = FRAMESIZE_SVGA;
  config.jpeg_quality = 10;
  config.fb_count = 2;

  pinMode(ledPin, OUTPUT);
  
  // camera init
  Serial.println("Chilling a bit before starting the camera");
  delay(3000);
  esp_err_t err = esp_camera_init(&config);
  if (err != ESP_OK) {
    Serial.printf("Camera init failed with error 0x%x", err);
    return;
  }
  delay(3000);
  Serial.println("Camera Started");
  sensor_t * s = esp_camera_sensor_get();
  // drop down frame size for higher initial frame rate
  s->set_framesize(s, FRAMESIZE_SVGA);

  WiFi.begin(ssid, password);

  while (WiFi.status() != WL_CONNECTED) {
    delay(500);
    Serial.print(".");
  }
  Serial.println("");
  Serial.println("WiFi connected");
  delay(500);
  webserver::startCameraServer();

  Serial.print("Camera Ready! Use 'http://");
  Serial.print(WiFi.localIP());
  Serial.println("' to connect");
  
  initWebSocket();
 
  // Start server
  server.begin();
}

void loop() {
  // put your main code here, to run repeatedly:
  ws.cleanupClients();  
}
